## conf/layer.conf
```bitbake
# We have a conf and classes directory, add to BBPATH
BBPATH .= ":${LAYERDIR}"

# We have recipes-* directories, add to BBFILES
BBFILES += "${LAYERDIR}/recipes-*/*/*.bb \
            ${LAYERDIR}/recipes-*/*/*.bbappend"

BBFILE_COLLECTIONS += "meta-external"
BBFILE_PATTERN_meta-external = "^${LAYERDIR}/"
BBFILE_PRIORITY_meta-external = "6"

LAYERDEPENDS_meta-external = "core"
LAYERSERIES_COMPAT_meta-external = "kirkstone"

IMAGE_INSTALL:append = " f2fs-tools tree tmux tcpdump hostapd mtr nmap"
IMAGE_INSTALL:append = " stm32flash spitools iperf2 iperf3 iftop lftp"
IMAGE_INSTALL:append = " lmsensors"
```
